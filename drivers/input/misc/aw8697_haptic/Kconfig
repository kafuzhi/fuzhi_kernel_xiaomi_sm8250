## drivers/input/misc/aw8697_haptic/Kconfig
```kconfig
#
# Awinic aw8697 driver
#

config INPUT_AW8697_HAPTIC
	tristate "Awinic AW8697 HAPTIC"
	depends on I2C
	help
	  Say Y here if you have Awinic AW8697 haptic controller
	  chip in your system.

	  If unsure, say N.

	  To compile this driver as a module, choose M here.

config INPUT_AW8697_HAPTIC_DAGU
	bool "Awinic AW8697 HAPTIC dagu driver"
	depends on INPUT_AW8697_HAPTIC
	help
	  Say Y here if you want to use the AW8697 driver from
	  dagu.

	  If unsure, say N.

config INPUT_AW8697_HAPTIC_FLYME_VIBRATOR
	bool "Flyme / Meizu vibrator compatibility nodes"
	depends on INPUT_AW8697_HAPTIC
	depends on !INPUT_AW8697_HAPTIC_DAGU
	default y
	help
	  Re-create the Meizu specific vibrator interface on top of the AW8697
	  haptic driver:

	    /sys/class/meizu/motor/{on_off,rtp,set_rtp,set_mback,set_cspress,
	                           waveform,freq,proline,haptic_audio}
	    /sys/class/timed_output/vibrator/enable

	  Flyme's userspace (FlymeVibratorHelper and Meizu's vibrator HAL)
	  drives the motor exclusively through those nodes, so vibration stays
	  dead on a device running a Flyme port unless they exist.

	  Say Y if the ROM's vibrator HAL or framework talks to the Meizu
	  motor nodes.  If unsure, say N.
```
